## src/modules/my_control/Kconfig
```kconfig
menuconfig MODULES_MY_CONTROL
	bool "my_control"
	default n
	---help---
		Enable the my_control simple UART read/write module
```

## src/modules/my_uart/Kconfig
```kconfig
menuconfig MODULES_MY_UART
	bool "my_uart"
	default n
	---help---
		Enable the my_uart simple UART read/write module
```

## src/modules/my_uart_test/Kconfig
```kconfig
menuconfig MODULES_MY_UART_TEST
	bool "my_uart_test"
	default n
	---help---
		Enable the my_uart simple UART read/write module
```
