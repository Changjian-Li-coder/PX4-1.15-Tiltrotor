## src/modules/my_control_allocation/Kconfig
```kconfig
menuconfig MODULES_MY_CONTROL_ALLOCATION
	bool "my_control_allocation"
	default n
	---help---
		Enable the my_control_allocation UART tilt control module
```

## src/modules/my_control_allocator/Kconfig
```kconfig
menuconfig MODULES_MY_CONTROL_ALLOCATOR
	bool "my_control_allocator"
	default n
	---help---
		Enable the my_control_allocator simple UART read/write module
```

## src/modules/my_control_test/Kconfig
```kconfig
menuconfig MODULES_MY_CONTROL_TEST
	bool "my_control_test"
	default n
	---help---
		Enable the my_control_test simple UART read/write module
```
